## config/boards/shields/moNa/Kconfig.shield
```kconfig
config SHIELD_MONA_L
    def_bool $(shields_list_contains,moNa_L)

config SHIELD_MONA_R
    def_bool $(shields_list_contains,moNa_R)
```

## config/west.yml
```yaml
manifest:
  remotes:
    - name: zmkfirmware
      url-base: https://github.com/zmkfirmware
    # Additional modules containing boards/shields/custom code can be listed here as well
    # See https://docs.zephyrproject.org/3.2.0/develop/west/manifest.html#projects
    - name: sayu-hub
      url-base: https://github.com/sayu-hub
  projects:
    - name: zmk
      remote: zmkfirmware
      revision: feat/pointers-move-scroll
      import: app/west.yml
    - name: zmk-pmw3610-driver
      remote: sayu-hub
      revision: main
  self:
    path: config
```
